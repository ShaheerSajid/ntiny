## software/linux/ntiny_defconfig
```kconfig
CONFIG_BLK_DEV_INITRD=y
# Pin the version string deterministically (avoids "-dirty" from
# scripts/setlocalversion when the kernel tree has uncommitted ntiny
# patches): 6.6.0-ntiny instead of 6.6.0-dirty.
CONFIG_LOCALVERSION="-ntiny"
# CONFIG_LOCALVERSION_AUTO is not set
CONFIG_INITRAMFS_SOURCE="@NTINY_LINUX@/initramfs.cpio"
CONFIG_INITRAMFS_COMPRESSION_NONE=y
CONFIG_EXPERT=y
CONFIG_SOC_VIRT=y
CONFIG_NONPORTABLE=y
CONFIG_ARCH_RV32I=y
CONFIG_RISCV_ISA_ZBB=y
# 6.12: disable boot-time unaligned-access probing (busy-loops on jiffies
# before timers settle). Tell kernel HW handles unaligned slow-but-OK.
CONFIG_RISCV_SLOW_UNALIGNED_ACCESS=y
# CONFIG_IRQ_STACKS is not set
CONFIG_RISCV_SBI_V01=y
CONFIG_CMDLINE="earlycon=sbi console=hvc0"
CONFIG_CMDLINE_FORCE=y
# CONFIG_STACKPROTECTOR is not set
# CONFIG_BLOCK is not set
# Headless RV32 SoC: console is HVC over SBI, no VT/keyboard/mouse.
# CONFIG_VT must go first — it `select INPUT`s, which otherwise pulls
# in CONFIG_MOUSE_PS2 + the full PS/2 driver family. Their __param
# entries trip a kernfs refcount underflow in param_sysfs_builtin_init
# on fresh (non-incremental) builds and panic init before /init runs.
# CONFIG_VT is not set
# CONFIG_INPUT is not set
# CONFIG_HID_SUPPORT is not set
CONFIG_DEVTMPFS=y
CONFIG_DEVTMPFS_MOUNT=y
CONFIG_SERIAL_EARLYCON_RISCV_SBI=y
CONFIG_HVC_RISCV_SBI=y
CONFIG_TMPFS=y
CONFIG_FTRACE=y
CONFIG_FTRACE_SYSCALLS=y
# Phase 1: driver Kconfigs for the upstream IPs the ntiny peripheral
# nodes target (see software/linux/ntiny.dts +
# docs/peripheral_standardization_plan.md). Drivers will probe, most
# will fail to bind until Phase 2 RTL refactors land — that's expected.
CONFIG_SERIAL_SIFIVE=y
CONFIG_SERIAL_SIFIVE_CONSOLE=y
CONFIG_GPIOLIB=y
CONFIG_GPIO_SYSFS=y
CONFIG_GPIO_SIFIVE=y
CONFIG_SPI=y
CONFIG_SPI_MASTER=y
CONFIG_SPI_SIFIVE=y
CONFIG_SPI_SPIDEV=y
CONFIG_I2C=y
CONFIG_I2C_CHARDEV=y
CONFIG_I2C_OCORES=y
CONFIG_PWM=y
CONFIG_PWM_SIFIVE=y
CONFIG_UIO=y
CONFIG_UIO_PDRV_GENIRQ=y
```

## software/linux/ntiny_no_c_defconfig
```kconfig
# ntiny rv32ima Linux kernel config (NO compressed instructions)
# Target: single-hart, 128MB RAM, OpenSBI, UART console
#
# This is the NO-C variant: compressed instructions disabled in the kernel
# to bypass the c_controller alignment FSM edge cases (sepc[1]=1 BRANCH state,
# stale ins_buffer interactions, etc.) while the fetch-unit revamp is in
# progress. See docs/fetch_revamp_plan.md §4 for the long-form rationale.
#
# Notes:
#   - arch/riscv/Kconfig has EFI_STUB → select RISCV_ISA_C, so EFI must also
#     be disabled for the C disable to actually take effect.
#   - HVC_RISCV_SBI and SERIAL_EARLYCON_RISCV_SBI both depend on RISCV_SBI_V01,
#     which is `default n`. olddefconfig will silently drop the console
#     drivers if RISCV_SBI_V01 isn't explicitly set, so we set it here too
#     (this is bug #12 — see docs/linux_boot_bugs_and_fixes.md).
#   - The OpenSBI build that consumes this kernel must use
#     PLATFORM_RISCV_ISA=rv32ima_zicsr_zifencei to match.
#   - Userspace (busybox/glibc) is still C-enabled because the riscv32-unknown-
#     linux-gnu toolchain emits compressed by default. So this only sidesteps
#     C edge cases on the kernel-side fetch path.

# Architecture
CONFIG_ARCH_RV32I=y
CONFIG_NONPORTABLE=y
# CONFIG_SMP is not set
CONFIG_MMU=y
# CONFIG_RISCV_ISA_C is not set
# CONFIG_EFI is not set

# SoC — use generic/virt as base
CONFIG_SOC_VIRT=y

# Memory
CONFIG_BLK_DEV_INITRD=y

# Disable heavy features
# CONFIG_MODULES is not set
# CONFIG_VIRTUALIZATION is not set
# CONFIG_PM is not set
# CONFIG_CPU_IDLE is not set
# CONFIG_HIGH_RES_TIMERS is not set
# CONFIG_PROFILING is not set
# CONFIG_BPF_SYSCALL is not set
# CONFIG_CGROUPS is not set
# CONFIG_NAMESPACES is not set
# CONFIG_NET is not set
# CONFIG_BLOCK is not set
# CONFIG_SWAP is not set

# Console — must enable RISCV_SBI_V01 because both HVC_RISCV_SBI and
# SERIAL_EARLYCON_RISCV_SBI depend on it. Without RISCV_SBI_V01=y, olddefconfig
# silently drops HVC_RISCV_SBI/EARLYCON_RISCV_SBI and the kernel boots in
# total silence (bug #12, see docs/linux_boot_bugs_and_fixes.md).
CONFIG_RISCV_SBI_V01=y
CONFIG_TTY=y
CONFIG_SERIAL_EARLYCON=y
CONFIG_SERIAL_EARLYCON_RISCV_SBI=y
CONFIG_HVC_RISCV_SBI=y
CONFIG_PRINTK=y

# Boot command line
CONFIG_CMDLINE="earlycon=sbi console=hvc0"
CONFIG_CMDLINE_FORCE=y

# Initramfs — must point at the cpio.gz that gets baked into the kernel image.
# Empty string here causes a "VFS: Unable to mount root fs on unknown-block(0,0)"
# panic at kernel_init → prepare_namespace → mount_root_generic.
CONFIG_BLK_DEV_INITRD=y
CONFIG_INITRAMFS_SOURCE="/home/shaheer/Documents/github/ntiny/software/linux/initramfs.cpio.gz"

# Minimal filesystem
CONFIG_PROC_FS=y
CONFIG_SYSFS=y
CONFIG_TMPFS=y
CONFIG_DEVTMPFS=y
CONFIG_DEVTMPFS_MOUNT=y

# Disable debug for size
# CONFIG_DEBUG_KERNEL is not set
# CONFIG_FTRACE is not set
```

## software/linux/ntiny_nommu_defconfig
```kconfig
# ntiny rv32ima NoMMU Linux kernel config
#
# Goal: rule out the MMU/privilege-transition path as a debug track. The kernel
# runs in M-mode directly (no OpenSBI, no S-mode, no Sv32). All instructions
# stay in M-mode, no SRET, no privilege drops, no ITLB/DTLB. The pipeline only
# exercises the basic M-mode instruction execution + traps + memory.
#
# If this boots cleanly: bug is in MMU/privilege transition path → fetch revamp
# is needed for the right reasons.
# If this also fails: bug is more fundamental → fetch revamp is even more
# urgent.
#
# Notes:
#   - No console driver: our UART is `ntiny,uart` not 8250-compatible. Boot is
#     silent; verify progress via the testbench's PC sampler in uart.log.
#   - Built with rv32ima (no compressed) for the same reasons as ntiny_no_c_defconfig.
#   - No userspace transition required for the test — even just reaching
#     `start_kernel()` and looping in something benign would be a positive signal.

# Architecture
CONFIG_ARCH_RV32I=y
CONFIG_NONPORTABLE=y
# CONFIG_SMP is not set
# CONFIG_MMU is not set
# CONFIG_RISCV_ISA_C is not set
# CONFIG_EFI is not set

# Embed device tree directly in kernel image. Without this, the kernel boots
# with a1=0 (no DTB pointer), can't find any memory regions, and panics in
# setup_arch on the first memblock_alloc. The DTS lives at
# arch/riscv/boot/dts/ntiny/ntiny_nommu.dts (copied from the project tree by
# build_nommu.sh on each build).
CONFIG_BUILTIN_DTB=y

# SoC base
CONFIG_SOC_VIRT=y

# Memory
CONFIG_BLK_DEV_INITRD=y
# CONFIG_RD_BZIP2 is not set
# CONFIG_RD_LZMA is not set
# CONFIG_RD_XZ is not set
# CONFIG_RD_LZO is not set
# CONFIG_RD_LZ4 is not set
CONFIG_INITRAMFS_SOURCE="/home/shaheer/Documents/github/ntiny/software/linux/initramfs_mini.cpio.gz"

# Size optimization
CONFIG_CC_OPTIMIZE_FOR_SIZE=y
CONFIG_EXPERT=y
CONFIG_SLUB=y
CONFIG_SLUB_TINY=y

# Disable heavy features
# CONFIG_MODULES is not set
# CONFIG_VIRTUALIZATION is not set
# CONFIG_PM is not set
# CONFIG_CPU_IDLE is not set
# CONFIG_HIGH_RES_TIMERS is not set
# CONFIG_PROFILING is not set
# CONFIG_BPF_SYSCALL is not set
# CONFIG_CGROUPS is not set
# CONFIG_NAMESPACES is not set
# CONFIG_NET is not set
# CONFIG_BLOCK is not set
# CONFIG_SWAP is not set
# CONFIG_KALLSYMS is not set
# CONFIG_VM_EVENT_COUNTERS is not set
# CONFIG_FHANDLE is not set
# CONFIG_BASE_FULL is not set
# CONFIG_EPOLL is not set
# CONFIG_SIGNALFD is not set
# CONFIG_TIMERFD is not set
# CONFIG_EVENTFD is not set
# CONFIG_AIO is not set
# CONFIG_IO_URING is not set
# CONFIG_ADVISE_SYSCALLS is not set

# Console — silent for now (no 8250-compatible UART driver). printk buffers
# but doesn't drain. Verify boot via testbench PC sampler.
CONFIG_TTY=y
CONFIG_PRINTK=y
# CONFIG_SERIAL_8250 is not set

# Boot command line — no console=, kernel will run silently
CONFIG_CMDLINE=""

# Minimal filesystem
CONFIG_BINFMT_FLAT=y
CONFIG_PROC_FS=y
CONFIG_SYSFS=y
CONFIG_TMPFS=y
CONFIG_DEVTMPFS=y
CONFIG_DEVTMPFS_MOUNT=y

# Disable debug for size
# CONFIG_DEBUG_KERNEL is not set
# CONFIG_FTRACE is not set
```

## software/linux/opensbi-platform/Kconfig
```kconfig
# SPDX-License-Identifier: BSD-2-Clause

config PLATFORM_NTINY
	bool "ntiny RISC-V SoC"
	select IRQCHIP_PLIC
	select IPI_MSWI
	select TIMER_MTIMER
	default y
```
